/*
 * Copyright (c) 2020 The ZMK Contributors
 * Copyright (c) 2025 Innaworks Development Limited, trading as MoErgo
 *
 * SPDX-License-Identifier: MIT
 */


/* THIS FILE WAS GENERATED BY GLOVE80 LAYOUT EDITOR
 *
 * This file was generated automatically. You may or may not want to
 * edit it directly.
 */

#include <behaviors.dtsi>
/* Include all behavior includes needed */
#include <dt-bindings/zmk/outputs.h>
#include <dt-bindings/zmk/keys.h>
#include <dt-bindings/zmk/bt.h>
#include <dt-bindings/zmk/rgb.h>

/* On demand includes */
#include <dt-bindings/zmk/input_transform.h>
#include <dt-bindings/zmk/pointing.h>
#include <input/processors.dtsi>

/* Helper Macros, based on https://github.com/urob/zmk-helpers/ */

#pragma once

#define ZMK_HELPER_STRINGIFY(x) #x

// Preprocessor mechanism to overload macros, cf. https://stackoverflow.com/a/27051616/6114651
#define VARGS_(_10, _9, _8, _7, _6, _5, _4, _3, _2, _1, N, ...) N
#define VARGS(...) VARGS_(__VA_ARGS__, 10, 9, 8, 7, 6, 5, 4, 3, 2, 1, 0)
#define CONCAT_(a, b) a##b
#define CONCAT(a, b) CONCAT_(a, b)

#define ZMK_BEHAVIOR_CORE_tap_dance  \
    compatible = "zmk,behavior-tap-dance"; \
    #binding-cells = <0>

#define ZMK_BEHAVIOR(name, type, ...) \
    name: name { \
        ZMK_BEHAVIOR_CORE_ ## type; \
        __VA_ARGS__ \
    };

#define ZMK_TAP_DANCE(name, ...) \
    ZMK_BEHAVIOR(name, tap_dance, __VA_ARGS__)

#define ZMK_TD_LAYER(name, layer) \
    ZMK_TAP_DANCE(name, \
        tapping-term-ms = <200>; \
        bindings = <&mo layer>, <&to layer>; \
)

/* Automatically generated layer name #define */
#define LAYER_HRM_macOS 0
#define LAYER_HRM_WinLinx 1
#define LAYER_Typing 2
#define LAYER_Autoshift 3
#define LAYER_Cursor_macOS 4
#define LAYER_Cursor 5
#define LAYER_Symbol 6
#define LAYER_Mouse 7
#define LAYER_MouseSlow 8
#define LAYER_MouseFast 9
#define LAYER_MouseWarp 10
#define LAYER_Gaming 11
#define LAYER_Lower 12
#define LAYER_Magic 13

/* To deal with the situation where there is no Lower layer, to keep &lower happy */
#ifndef LAYER_Lower
#define LAYER_Lower 0
#endif

/* Custom Device-tree */
//////////////////////////////////////////////////////////////////////////////////
// KeyLight Configurator simplifies per-key RGB configuration (PR36):
// - Starting from scratch: Easily create layers and assign colors intuitively.
// - Glorious Engrammer or TailorKey users can simply paste their device tree here.
// Once you're done, just copy the device tree into the Layout Editor.
// TIP: You can select multiple keys with Ctrl and/or edit text in the Device Tree
//////////////////////////////////////////////////////////////////////////////////

#if __has_include(<dt-bindings/zmk/rgb_colors.h>)
  //
  // Color definitions with conflict guard to prevent
  // accidental redefinition of common abbreviations.
  //
  #if defined(RED) || defined(RED_RGB) || \
      defined(COR) || defined(COR_RGB) || \
      defined(ORN) || defined(ORN_RGB) || \
      defined(GDN) || defined(GDN_RGB) || \
      defined(GOL) || defined(GOL_RGB) || \
      defined(YLW) || defined(YLW_RGB) || \
      defined(CHU) || defined(CHU_RGB) || \
      defined(GRN) || defined(GRN_RGB) || \
      defined(SPG) || defined(SPG_RGB) || \
      defined(CYN) || defined(CYN_RGB) || \
      defined(AZU) || defined(AZU_RGB) || \
      defined(TEA) || defined(TEA_RGB) || \
      defined(TUR) || defined(TUR_RGB) || \
      defined(BLU) || defined(BLU_RGB) || \
      defined(PUR) || defined(PUR_RGB) || \
      defined(MAJ) || defined(MAJ_RGB) || \
      defined(PNK) || defined(PNK_RGB) || \
      defined(WHT) || defined(WHT_RGB) || \
      defined(BLK) || defined(BLK_RGB) || \
      defined(___) || \
      defined(DUG) || defined(DUG_RGB) || \
      defined(LAC) || defined(LAC_RGB) || \
      defined(BSL) || defined(BNL) || defined(BCL) || \
      defined(SSL) || defined(SNL) || defined(SCL) || \
      defined(FST) || defined(WRP) || defined(SLO)
  #error "Naming conflict: 3-letter color abbreviation already defined!"
  #endif

  //
  // color definitions from QMK
  // https://github.com/qmk/qmk_firmware/blob/master/quantum/color.h
  //
  #define RED_RGB 0xFF0000 // #FF0000 RED      => RED (red)
  #define COR_RGB 0xFF7C4D // #FF7C4D CORAL    => COR (coral)
  #define ORN_RGB 0xFF8000 // #FF8000 ORANGE   => ORN (ornj)
  #define GDN_RGB 0xD9A521 // #D9A521 GOLDNROD => GDN (gold'nrod)
  #define GOL_RGB 0xFFD900 // #FFD900 GOLD     => GOL (gold)
  #define YLW_RGB 0xFFFF00 // #FFFF00 YELLOW   => YLW (yellow)
  #define CHU_RGB 0x80FF00 // #80FF00 CHARTRSE => CHU (chartreuse)
  #define GRN_RGB 0x00FF00 // #00FF00 GREEN    => GRN (green)
  #define SPG_RGB 0x00FF80 // #00FF80 SPRINGRN => SPG (spring green)
  #define CYN_RGB 0x00FFFF // #00FFFF CYAN     => CYN (sigh-an)
  #define AZU_RGB 0x99F5FF // #99F5FF AZURE    => AZU (a-zur)
  #define TEA_RGB 0x008080 // #008080 TEAL     => TEA (teel)
  #define TUR_RGB 0x476E6A // #476E6A TURQUOIS => TUR (turquoise)
  #define BLU_RGB 0x0000FF // #0000FF BLUE     => BLU (bloo)
  #define PUR_RGB 0x7A00FF // #7A00FF PURPLE   => PUR (purp)
  #define MAJ_RGB 0xFF00FF // #FF00FF MAGENTA  => MAJ (mah-jenta)
  #define PNK_RGB 0xFF80BF // #FF80BF PINK     => PNK (pink)
  #define WHT_RGB 0xFFFFFF // #FFFFFF WHITE    => WHT (white)
  #define BLK_RGB 0x000000 // #000000 BLACK    => BLK (blak)

  //
  // color definitions from MoErgo
  // https://github.com/moergo-sc/zmk/blob/aca523dfce9b6447ffd19d833b791d44f1f286de/app/src/rgb_underglow.c#L259-L265
  //
  #define DUG_RGB 0x00ff68 // #00ff68 DULL_GRN => DUG (dull green)
  #define LAC_RGB 0x6b1fce // #6b1fce LILAC    => LAC (lilac)

  //
  // underglow for the colors above
  //
  #define RED &ug RED_RGB
  #define COR &ug COR_RGB
  #define ORN &ug ORN_RGB
  #define GDN &ug GDN_RGB
  #define GOL &ug GOL_RGB
  #define YLW &ug YLW_RGB
  #define CHU &ug CHU_RGB
  #define GRN &ug GRN_RGB
  #define SPG &ug SPG_RGB
  #define CYN &ug CYN_RGB
  #define AZU &ug AZU_RGB
  #define TEA &ug TEA_RGB
  #define TUR &ug TUR_RGB
  #define BLU &ug BLU_RGB
  #define PUR &ug PUR_RGB
  #define MAJ &ug MAJ_RGB
  #define PNK &ug PNK_RGB
  #define WHT &ug WHT_RGB
  #define ___ &ug BLK_RGB
  #define DUG &ug DUG_RGB
  #define LAC &ug LAC_RGB

  //
  // underglow for keyboard locks on the Base layer
  //
  #define BSL &ug_sl BLK_RGB RED_RGB // ScrollLock COLOR_OFF COLOR_ON
  #define BNL &ug_nl BLK_RGB RED_RGB // NumLock    COLOR_OFF COLOR_ON
  #define BCL &ug_cl BLK_RGB RED_RGB // CapsLock   COLOR_OFF COLOR_ON


  //
  // colors for mouse speed scaling in Mouse layers
  //
  #define FST GOL
  #define WRP CHU
  #define SLO COR



  // ==== PER-KEY-RGB <section begins> ====
  / {
    underglow-layer {
      compatible = "zmk,underglow-layer";

   
      #ifdef LAYER_HRM_WinLinx
      HRM_WinLinx {
        bindings = <
          ___ ___ BCL BNL BSL                                             ___ ___ ___ ___ ___
          ___ ___ ___ ___ ___ ___                                     ___ ___ ___ ___ ___ ___
          ___ ___ ___ ___ ___ ___                                     ___ ___ ___ ___ ___ ___
          ___ MAJ CYN CHU YLW ___                                     ___ YLW CHU CYN MAJ ___
          ___ ___ ___ ___ ___ ___     ___ ___ ___     ___ ___ ___     ___ ___ ___ ___ ___ ___
          ___ ___ ___ ___ ___         ___ ___ ___     ___ ___ ___         ___ ___ ___ ___ ___
        >;
        layer-id = <LAYER_HRM_WinLinx>;
        fade-delay = <15>;
      };
      #endif

      #ifdef LAYER_HRM_macOS
      HRM_macOS {
        bindings = <
          ___ ___ BCL BNL BSL                                             ___ ___ ___ ___ ___
          ___ ___ ___ ___ ___ ___                                     ___ ___ ___ ___ ___ ___
          ___ ___ ___ ___ ___ ___                                     ___ ___ ___ ___ ___ ___
          ___ DUG CYN MAJ YLW ___                                     ___ YLW MAJ CYN DUG ___
          ___ ___ ___ ___ ___ ___     ___ ___ ___     ___ ___ ___     ___ ___ ___ ___ ___ ___
          ___ ___ ___ ___ ___         ___ ___ ___     ___ ___ ___         ___ ___ ___ ___ ___
        >;
        layer-id = <LAYER_HRM_macOS>;
        fade-delay = <15>;
      };
      #endif

      #ifdef LAYER_Lower
      Lower {
        bindings = <
          MAJ MAJ BLU BLU BLU                                             BLU BLU BLU ___ ORN
          ___ ___ ___ ___ ___ GRN                                     WHT ORN WHT WHT WHT ORN
          ___ ___ ___ GRN ___ GRN                                     WHT WHT WHT WHT WHT ORN
          ___ ___ GRN GRN GRN GRN                                     WHT WHT WHT WHT WHT ___
          ___ ORN ___ WHT WHT GRN     ___ ___ ___     ___ ___ ___     WHT WHT WHT WHT WHT ___
          ___ ORN ORN WHT WHT         ___ ___ ___     ___ ___ ___         WHT WHT WHT WHT ___
        >;
        layer-id = <LAYER_Lower>;
        fade-delay = <15>;
      };
      #endif

  #ifdef LAYER_Autoshift
  Autoshift {
    bindings = <
          ___ ___ ___ ___ ___                                             ___ ___ ___ ___ ___
          YLW YLW YLW YLW YLW YLW                                     YLW YLW YLW YLW YLW YLW
          ___ YLW YLW YLW YLW YLW                                     YLW YLW YLW YLW YLW YLW
          ___ YLW YLW YLW YLW YLW                                     YLW YLW YLW YLW YLW ___
          YLW YLW YLW YLW YLW YLW     YLW GRN ___     MAJ GRN YLW     YLW YLW YLW YLW YLW ___
          ___ ___ ___ ___ ___         ___ ___ CYN     CYN ___ ___         YLW YLW ___ ___ ___
    >;
    layer-id = <LAYER_Autoshift>;
    fade-delay = <5>;
  };
  #endif

  #ifdef LAYER_LeftPinky
  LeftPinky {
    bindings = <
          ___ ___ ___ ___ ___                                             ___ ___ ___ ___ ___
          ___ ___ ___ ___ ___ ___                                     ___ ___ ___ ___ ___ ___
          ___ ___ ___ ___ ___ ___                                     ___ ___ ___ ___ ___ ___
          ___ MAJ ___ ___ ___ ___                                     ___ ___ ___ ___ ___ ___
          ___ ___ ___ ___ ___ ___     ___ ___ ___     MAJ ___ ___     ___ ___ ___ ___ ___ ___
          ___ ___ ___ ___ ___         ___ ___ ___     ___ ___ ___         ___ ___ ___ ___ ___
    >;
    layer-id = <LAYER_LeftPinky>;
    fade-delay = <15>;
  };
  #endif

  #ifdef LAYER_LeftRingy
  LeftRingy {
    bindings = <
          ___ ___ ___ ___ ___                                             ___ ___ ___ ___ ___
          ___ ___ ___ ___ ___ ___                                     ___ ___ ___ ___ ___ ___
          ___ ___ ___ ___ ___ ___                                     ___ ___ ___ ___ ___ ___
          ___ ___ CYN ___ ___ ___                                     ___ ___ ___ ___ ___ ___
          ___ ___ ___ ___ ___ ___     ___ ___ ___     ___ ___ ___     ___ ___ ___ ___ ___ ___
          ___ ___ ___ ___ ___         ___ ___ CYN     ___ ___ ___         ___ ___ ___ ___ ___
    >;
    layer-id = <LAYER_LeftRingy>;
    fade-delay = <15>;
  };
  #endif

  #ifdef LAYER_LeftMiddy
  LeftMiddy {
    bindings = <
          ___ ___ ___ ___ ___                                             ___ ___ ___ ___ ___
          ___ ___ ___ ___ ___ ___                                     ___ ___ ___ ___ ___ ___
          ___ ___ ___ ___ ___ ___                                     ___ ___ ___ ___ ___ ___
          ___ ___ ___ DUG ___ ___                                     ___ ___ ___ ___ ___ ___
          ___ ___ ___ ___ ___ ___     ___ GRN ___     ___ ___ ___     ___ ___ ___ ___ ___ ___
          ___ ___ ___ ___ ___         ___ ___ ___     ___ ___ ___         ___ ___ ___ ___ ___
    >;
    layer-id = <LAYER_LeftMiddy>;
    fade-delay = <15>;
  };
  #endif

  #ifdef LAYER_LeftIndex
  LeftIndex {
    bindings = <
          ___ ___ ___ ___ ___                                             ___ ___ ___ ___ ___
          ___ ___ ___ ___ ___ ___                                     ___ ___ ___ ___ ___ ___
          ___ ___ ___ ___ ___ ___                                     ___ ___ ___ ___ ___ ___
          ___ ___ ___ ___ YLW ___                                     ___ ___ ___ ___ ___ ___
          ___ ___ ___ ___ ___ ___     YLW ___ ___     ___ ___ ___     ___ ___ ___ ___ ___ ___
          ___ ___ ___ ___ ___         ___ ___ ___     ___ ___ ___         ___ ___ ___ ___ ___
    >;
    layer-id = <LAYER_LeftIndex>;
    fade-delay = <15>;
  };
  #endif

  #ifdef LAYER_RightIndex
  RightIndex {
    bindings = <
          ___ ___ ___ ___ ___                                             ___ ___ ___ ___ ___
          ___ ___ ___ ___ ___ ___                                     ___ ___ ___ ___ ___ ___
          ___ ___ ___ ___ ___ ___                                     ___ ___ ___ ___ ___ ___
          ___ ___ ___ ___ ___ ___                                     ___ YLW ___ ___ ___ ___
          ___ ___ ___ ___ ___ ___     ___ ___ ___     ___ ___ YLW     ___ ___ ___ ___ ___ ___
          ___ ___ ___ ___ ___         ___ ___ ___     ___ ___ ___         ___ ___ ___ ___ ___
    >;
    layer-id = <LAYER_RightIndex>;
    fade-delay = <15>;
  };
  #endif

  #ifdef LAYER_RightMiddy
  RightMiddy {
    bindings = <
          ___ ___ ___ ___ ___                                             ___ ___ ___ ___ ___
          ___ ___ ___ ___ ___ ___                                     ___ ___ ___ ___ ___ ___
          ___ ___ ___ ___ ___ ___                                     ___ ___ ___ ___ ___ ___
          ___ ___ ___ ___ ___ ___                                     ___ ___ GRN ___ ___ ___
          ___ ___ ___ ___ ___ ___     ___ ___ ___     ___ GRN ___     ___ ___ ___ ___ ___ ___
          ___ ___ ___ ___ ___         ___ ___ ___     ___ ___ ___         ___ ___ ___ ___ ___
    >;
    layer-id = <LAYER_RightMiddy>;
    fade-delay = <15>;
  };
  #endif

  #ifdef LAYER_RightRingy
  RightRingy {
    bindings = <
          ___ ___ ___ ___ ___                                             ___ ___ ___ ___ ___
          ___ ___ ___ ___ ___ ___                                     ___ ___ ___ ___ ___ ___
          ___ ___ ___ ___ ___ ___                                     ___ ___ ___ ___ ___ ___
          ___ ___ ___ ___ ___ ___                                     ___ ___ ___ CYN ___ ___
          ___ ___ ___ ___ ___ ___     ___ ___ ___     ___ ___ ___     ___ ___ ___ ___ ___ ___
          ___ ___ ___ ___ ___         ___ ___ CYN     ___ ___ ___         ___ ___ ___ ___ ___
    >;
    layer-id = <LAYER_RightRingy>;
    fade-delay = <15>;
  };
  #endif

  #ifdef LAYER_RightPinky
  RightPinky {
    bindings = <
          ___ ___ ___ ___ ___                                             ___ ___ ___ ___ ___
          ___ ___ ___ ___ ___ ___                                     ___ ___ ___ ___ ___ ___
          ___ ___ ___ ___ ___ ___                                     ___ ___ ___ ___ ___ ___
          ___ ___ ___ ___ ___ ___                                     ___ ___ ___ ___ MAJ ___
          ___ ___ ___ ___ ___ ___     ___ ___ ___     MAJ ___ ___     ___ ___ ___ ___ ___ ___
          ___ ___ ___ ___ ___         ___ ___ ___     ___ ___ ___         ___ ___ ___ ___ ___
    >;
    layer-id = <LAYER_RightPinky>;
    fade-delay = <15>;
  };
  #endif

  #ifdef LAYER_Cursor
  Cursor {
    bindings = <
          ___ ___ ___ ___ ___                                             ___ ___ ___ ___ ___
          ___ ORN ORN ORN ORN ___                                     ___ ___ ___ ___ ___ ___
          ___ ORN ORN ORN ORN YLW                                     YLW ORN PNK PNK ORN ___
          WHT WHT WHT WHT WHT YLW                                     YLW GRN GRN GRN GRN WHT
          MAJ CYN CYN CYN MAJ YLW     ___ ___ ___     CYN CYN CYN     YLW GRN GRN GRN GRN MAJ
          ___ ___ ___ MAJ MAJ         ___ DUG ___     CYN CYN CYN         MAJ MAJ MAJ MAJ ___
    >;
    layer-id = <LAYER_Cursor>;
    fade-delay = <5>;
  };
  #endif

  #ifdef LAYER_Cursor_macOS
  Cursor_macOS {
    bindings = <
          ___ ___ ___ ___ ___                                             ___ ___ ___ ___ ___
          ___ ORN ORN ORN ORN ___                                     ___ ___ ___ ___ ___ ___
          ___ ORN ORN ORN ORN YLW                                     YLW ORN PNK PNK ORN ___
          WHT WHT WHT WHT WHT YLW                                     YLW GRN GRN GRN GRN WHT
          MAJ CYN CYN CYN MAJ YLW     ___ ___ ___     CYN CYN CYN     YLW GRN GRN GRN GRN MAJ
          ___ ___ ___ MAJ MAJ         ___ DUG ___     CYN CYN CYN         MAJ MAJ MAJ MAJ ___
    >;
    layer-id = <LAYER_Cursor_macOS>;
    fade-delay = <5>;
  };
  #endif

  #ifdef LAYER_Symbol
  Symbol {
    bindings = <
          ___ ___ ___ ___ ___                                             ___ ___ ___ ___ ___
          MAJ AZU AZU AZU YLW YLW                                     ___ ___ ___ ___ ___ ___
          AZU MAJ AZU AZU YLW YLW                                     MAJ WHT WHT WHT WHT ___
          YLW YLW CHU ORN YLW YLW                                     MAJ ORN ORN ORN ORN ___
          MAJ CHU CHU CHU CHU YLW     MAJ YLW YLW     ___ ___ ___     MAJ ORN ORN ORN ORN ___
          YLW ORN MAJ MAJ ORN         YLW YLW YLW     ___ DUG ___         ___ ___ ___ ___ ___
    >;
    layer-id = <LAYER_Symbol>;
    fade-delay = <5>;
  };
  #endif

  #ifdef LAYER_Mouse
  Mouse {
    bindings = <
          ___ ___ ___ ___ ___                                             ___ ___ ___ ___ ___
          ___ ___ ___ ___ ___ ___                                     ___ ___ ___ ___ ___ ___
          ___ ___ LAC AZU LAC ___                                     ___ WHT WHT WHT WHT ___
          ___ TEA AZU AZU AZU ___                                     ___ FST WRP SLO YLW PNK
          ___ TEA SLO WRP FST ___     MAJ ___ PNK     ___ ___ ___     ___ LAC AZU LAC ORN PNK
          ___ ___ ___ ___ ___         YLW ORN PNK     ___ DUG ___         AZU AZU AZU MAJ ___
    >;
    layer-id = <LAYER_Mouse>;
    fade-delay = <5>;
  };
  #endif

  #ifdef LAYER_MouseFast
  MouseFast {
    bindings = <
          ___ ___ ___ ___ ___                                             ___ ___ ___ ___ ___
          ___ ___ ___ ___ ___ ___                                     ___ YLW GRN CYN MAJ ___
          ___ ___ FST FST FST ___                                     ___ FST FST FST FST ___
          ___ FST FST FST FST ___                                     ___ FST WRP SLO ___ ___
          ___ FST SLO WRP FST ___     MAJ ___ PNK     ___ ___ ___     ___ FST FST FST FST ___
          ___ ___ ___ ___ ___         YLW ORN PNK     ___ DUG ___         YLW ORN MAJ PNK PNK
    >;
    layer-id = <LAYER_MouseFast>;
    fade-delay = <5>;
  };
  #endif

  #ifdef LAYER_MouseWarp
  MouseWarp {
    bindings = <
          ___ ___ ___ ___ ___                                             ___ ___ ___ ___ ___
          ___ ___ ___ ___ ___ ___                                     ___ YLW GRN CYN MAJ ___
          ___ ___ WRP WRP WRP ___                                     ___ WRP WRP WRP WRP ___
          ___ WRP WRP WRP WRP ___                                     ___ FST WRP SLO ___ ___
          ___ WRP SLO WRP FST ___     MAJ ___ PNK     ___ ___ ___     ___ WRP WRP WRP WRP ___
          ___ ___ ___ ___ ___         YLW ORN PNK     ___ DUG ___         YLW ORN MAJ PNK PNK
    >;
    layer-id = <LAYER_MouseWarp>;
    fade-delay = <5>;
  };
  #endif

  #ifdef LAYER_MouseSlow
  MouseSlow {
    bindings = <
      ___ ___ ___ ___ ___                                             ___ ___ ___ ___ ___
      ___ ___ ___ ___ ___ ___                                     ___ YLW GRN CYN MAJ ___
      ___ ___ SLO SLO SLO ___                                     ___ SLO SLO SLO SLO ___
      ___ SLO SLO SLO SLO ___                                     ___ FST WRP SLO ___ ___
      ___ SLO SLO WRP FST ___     MAJ ___ PNK     ___ ___ ___     ___ SLO SLO SLO SLO ___
      ___ ___ ___ ___ ___         YLW ORN PNK     ___ DUG ___         YLW ORN MAJ PNK PNK
    >;
    layer-id = <LAYER_MouseSlow>;
    fade-delay = <5>;
  };
  #endif

  #ifdef LAYER_Gaming
  Gaming {
    bindings = <
      ORN ___ ___ ___ ___                                             ___ ___ ___ ___ ___
      ___ ___ ___ ___ ___ ___                                     ___ ___ ___ ___ ___ ___
      ___ ___ ___ ___ ___ ___                                     ___ ___ ___ ___ ___ ___
      ___ ___ ___ AZU ___ ___                                     ___ ___ ___ ___ ___ ___
      ___ YLW AZU AZU AZU ___     YLW CYN RED     ORN AZU ___     ___ ___ ___ ___ ___ ___
      ___ GRN ___ ___ ___         ___ GRN RED     AZU AZU AZU         ___ ___ ___ ___ ___
    >;
    layer-id = <LAYER_Gaming>;
    fade-delay = <15>;
     };
      #endif

    };
  };
  // ==== PER-KEY-RGB <section ends> =====

  #undef RED
  #undef RED_RGB
  #undef COR
  #undef COR_RGB
  #undef ORN
  #undef ORN_RGB
  #undef GDN
  #undef GDN_RGB
  #undef GOL
  #undef GOL_RGB
  #undef YLW
  #undef YLW_RGB
  #undef CHU
  #undef CHU_RGB
  #undef GRN
  #undef GRN_RGB
  #undef SPG
  #undef SPG_RGB
  #undef CYN
  #undef CYN_RGB
  #undef AZU
  #undef AZU_RGB
  #undef TEA
  #undef TEA_RGB
  #undef TUR
  #undef TUR_RGB
  #undef BLU
  #undef BLU_RGB
  #undef PUR
  #undef PUR_RGB
  #undef MAJ
  #undef MAJ_RGB
  #undef PNK
  #undef PNK_RGB
  #undef WHT
  #undef WHT_RGB
  #undef BLK
  #undef BLK_RGB
  #undef ___
  #undef DUG
  #undef DUG_RGB
  #undef LAC
  #undef LAC_RGB

  #undef BSL
  #undef BNL
  #undef BCL

  #undef SSL
  #undef SNL
  #undef SCL

  #undef FST
  #undef WRP
  #undef SLO
#endif


/* Input Listeners */
&mmv_input_listener {
    // LAYER_MouseSlow
    LAYER_MouseSlow {
        layers = <8>;
        input-processors = <&zip_xy_scaler 1 9>;
    };
    // LAYER_MouseFast
    LAYER_MouseFast {
        layers = <9>;
        input-processors = <&zip_xy_scaler 3 1>;
    };
    // LAYER_MouseWarp
    LAYER_MouseWarp {
        layers = <10>;
        input-processors = <&zip_xy_scaler 12 1>;
    };
};

&msc_input_listener {
    // LAYER_MouseSlow
    // 
    LAYER_MouseSlow {
        layers = <8>;
        input-processors = <&zip_scroll_scaler 1 9>;
    };
    // LAYER_MouseFast
    LAYER_MouseFast {
        layers = <9>;
        input-processors = <&zip_scroll_scaler 3 1>;
    };
    // LAYER_MouseWarp
    LAYER_MouseWarp {
        layers = <10>;
        input-processors = <&zip_scroll_scaler 12 1>;
    };
};

/* System behavior and Macros */
/ {
    behaviors {
        ZMK_TD_LAYER(lower, LAYER_Lower)
    };
};

/ {
    macros {
        rgb_ug_status_macro: rgb_ug_status_macro {
            label = "RGB_UG_STATUS";
            compatible = "zmk,behavior-macro";
            #binding-cells = <0>;
            bindings
                = <&rgb_ug RGB_STATUS>;
        };
    };
};


/ {
#ifdef BT_DISC_CMD
    behaviors {
        bt_0: bt_0 {
            compatible = "zmk,behavior-tap-dance";
            label = "BT_0";
            #binding-cells = <0>;
            tapping-term-ms = <200>;
            bindings = <&bt_select_0>, <&bt BT_DISC 0>;
        };
        bt_1: bt_1 {
            compatible = "zmk,behavior-tap-dance";
            label = "BT_1";
            #binding-cells = <0>;
            tapping-term-ms = <200>;
            bindings = <&bt_select_1>, <&bt BT_DISC 1>;
        };
        bt_2: bt_2 {
            compatible = "zmk,behavior-tap-dance";
            label = "BT_2";
            #binding-cells = <0>;
            tapping-term-ms = <200>;
            bindings = <&bt_select_2>, <&bt BT_DISC 2>;
        };
        bt_3: bt_3 {
            compatible = "zmk,behavior-tap-dance";
            label = "BT_3";
            #binding-cells = <0>;
            tapping-term-ms = <200>;
            bindings = <&bt_select_3>, <&bt BT_DISC 3>;
        };
    };
    macros {
        bt_select_0: bt_select_0 {
            label = "BT_SELECT_0";
            compatible = "zmk,behavior-macro";
            #binding-cells = <0>;
            bindings
                = <&out OUT_BLE>,
                  <&bt BT_SEL 0>;
        };
        bt_select_1: bt_select_1 {
            label = "BT_SELECT_1";
            compatible = "zmk,behavior-macro";
            #binding-cells = <0>;
            bindings
                = <&out OUT_BLE>,
                  <&bt BT_SEL 1>;
        };
        bt_select_2: bt_select_2 {
            label = "BT_SELECT_2";
            compatible = "zmk,behavior-macro";
            #binding-cells = <0>;
            bindings
                = <&out OUT_BLE>,
                  <&bt BT_SEL 2>;
        };
        bt_select_3: bt_select_3 {
            label = "BT_SELECT_3";
            compatible = "zmk,behavior-macro";
            #binding-cells = <0>;
            bindings
                = <&out OUT_BLE>,
                  <&bt BT_SEL 3>;
        };
    };
#else
    macros {
        bt_0: bt_0 {
            label = "BT_0";
            compatible = "zmk,behavior-macro";
            #binding-cells = <0>;
            bindings
                = <&out OUT_BLE>,
                  <&bt BT_SEL 0>;
        };
        bt_1: bt_1 {
            label = "BT_1";
            compatible = "zmk,behavior-macro";
            #binding-cells = <0>;
            bindings
                = <&out OUT_BLE>,
                  <&bt BT_SEL 1>;
        };
        bt_2: bt_2 {
            label = "BT_2";
            compatible = "zmk,behavior-macro";
            #binding-cells = <0>;
            bindings
                = <&out OUT_BLE>,
                  <&bt BT_SEL 2>;
        };
        bt_3: bt_3 {
            label = "BT_3";
            compatible = "zmk,behavior-macro";
            #binding-cells = <0>;
            bindings
                = <&out OUT_BLE>,
                  <&bt BT_SEL 3>;
        };
    };
#endif
};

/ {
    behaviors {
        magic: magic {
            compatible = "zmk,behavior-hold-tap";
            label = "MAGIC_HOLD_TAP";
            #binding-cells = <2>;
            flavor = "tap-preferred";
            tapping-term-ms = <200>;
            bindings = <&mo>, <&rgb_ug_status_macro>;
        };
    };
};

/* #define for key positions */
#define POS_LH_T1 52
#define POS_LH_T2 53
#define POS_LH_T3 54
#define POS_LH_T4 69
#define POS_LH_T5 70
#define POS_LH_T6 71
#define POS_LH_C1R2 15
#define POS_LH_C1R3 27
#define POS_LH_C1R4 39
#define POS_LH_C1R5 51
#define POS_LH_C2R1 4
#define POS_LH_C2R2 14
#define POS_LH_C2R3 26
#define POS_LH_C2R4 38
#define POS_LH_C2R5 50
#define POS_LH_C2R6 68
#define POS_LH_C3R1 3
#define POS_LH_C3R2 13
#define POS_LH_C3R3 25
#define POS_LH_C3R4 37
#define POS_LH_C3R5 49
#define POS_LH_C3R6 67
#define POS_LH_C4R1 2
#define POS_LH_C4R2 12
#define POS_LH_C4R3 24
#define POS_LH_C4R4 36
#define POS_LH_C4R5 48
#define POS_LH_C4R6 66
#define POS_LH_C5R1 1
#define POS_LH_C5R2 11
#define POS_LH_C5R3 23
#define POS_LH_C5R4 35
#define POS_LH_C5R5 47
#define POS_LH_C5R6 65
#define POS_LH_C6R1 0
#define POS_LH_C6R2 10
#define POS_LH_C6R3 22
#define POS_LH_C6R4 34
#define POS_LH_C6R5 46
#define POS_LH_C6R6 64
#define POS_RH_T1 57
#define POS_RH_T2 56
#define POS_RH_T3 55
#define POS_RH_T4 74
#define POS_RH_T5 73
#define POS_RH_T6 72
#define POS_RH_C1R2 16
#define POS_RH_C1R3 28
#define POS_RH_C1R4 40
#define POS_RH_C1R5 58
#define POS_RH_C2R1 5
#define POS_RH_C2R2 17
#define POS_RH_C2R3 29
#define POS_RH_C2R4 41
#define POS_RH_C2R5 59
#define POS_RH_C2R6 75
#define POS_RH_C3R1 6
#define POS_RH_C3R2 18
#define POS_RH_C3R3 30
#define POS_RH_C3R4 42
#define POS_RH_C3R5 60
#define POS_RH_C3R6 76
#define POS_RH_C4R1 7
#define POS_RH_C4R2 19
#define POS_RH_C4R3 31
#define POS_RH_C4R4 43
#define POS_RH_C4R5 61
#define POS_RH_C4R6 77
#define POS_RH_C5R1 8
#define POS_RH_C5R2 20
#define POS_RH_C5R3 32
#define POS_RH_C5R4 44
#define POS_RH_C5R5 62
#define POS_RH_C5R6 78
#define POS_RH_C6R1 9
#define POS_RH_C6R2 21
#define POS_RH_C6R3 33
#define POS_RH_C6R4 45
#define POS_RH_C6R5 63
#define POS_RH_C6R6 79

/* Custom Defined Behaviors */
/ {

};

/* Generated input processors */


/* Automatically generated macro definitions */
/ {
    macros {

        // AutoShift Helper- &AS main macro is chained to &AS_HT hold tap and &AS_Shifted macro - TailorKey
        AS_Shifted_v1_TKZ: AS_Shifted_v1_TKZ {
            label = "&AS_SHIFTED_V1_TKZ";
            compatible = "zmk,behavior-macro-one-param";
            #binding-cells = <1>;
            bindings = <&macro_press>
                , <&kp LSHFT>
                , <&macro_tap>
                , <&macro_param_1to1>
                , <&kp N1>
                , <&macro_release>
                , <&kp LSHFT>;
        };

        // AutoShift (Assign &AS to a Key) - &AS main macro is chained to &AS_HT hold tap and &AS_Shifted macro - TailorKey
        AS_v1_TKZ: AS_v1_TKZ {
            label = "&AS_V1_TKZ";
            compatible = "zmk,behavior-macro-one-param";
            #binding-cells = <1>;
            tap-ms = <10>;
            wait-ms = <10>;
            bindings = <&macro_press>
                , <&macro_param_1to1>
                , <&macro_param_1to2>
                , <&AS_HT_v2_TKZ A A>
                , <&macro_pause_for_release>
                , <&macro_release>
                , <&macro_param_1to1>
                , <&macro_param_1to2>
                , <&AS_HT_v2_TKZ A A>;
        };

        // Cursor Layer - Extent Line (seq) - TailorKey
        cur_EXTEND_LINE_macos_v1_TKZ: cur_EXTEND_LINE_macos_v1_TKZ {
            label = "&CUR_EXTEND_LINE_MACOS_V1_TKZ";
            compatible = "zmk,behavior-macro";
            #binding-cells = <0>;
            tap-ms = <1>;
            wait-ms = <1>;
            bindings = <&kp LG(LS(RIGHT))>;
        };

        // Cursor Layer - Extent Line (seq) - TailorKey
        cur_EXTEND_LINE_v1_TKZ: cur_EXTEND_LINE_v1_TKZ {
            label = "&CUR_EXTEND_LINE_V1_TKZ";
            compatible = "zmk,behavior-macro";
            #binding-cells = <0>;
            tap-ms = <1>;
            wait-ms = <1>;
            bindings = <&kp LS(END)>;
        };

        // Cursor Layer - Extend Word (seq) - TailorKey
        cur_EXTEND_WORD_macos_v1_TKZ: cur_EXTEND_WORD_macos_v1_TKZ {
            label = "&CUR_EXTEND_WORD_MACOS_V1_TKZ";
            compatible = "zmk,behavior-macro";
            #binding-cells = <0>;
            tap-ms = <1>;
            wait-ms = <1>;
            bindings = <&kp LA(LS(RIGHT))>;
        };

        // Cursor Layer - Extend Word (seq) - TailorKey
        cur_EXTEND_WORD_v1_TKZ: cur_EXTEND_WORD_v1_TKZ {
            label = "&CUR_EXTEND_WORD_V1_TKZ";
            compatible = "zmk,behavior-macro";
            #binding-cells = <0>;
            tap-ms = <1>;
            wait-ms = <1>;
            bindings = <&kp LC(LS(RIGHT))>;
        };

        // Cursor Layer macos - Select Line (seq) - TailorKey
        cur_SELECT_LINE_macos_v1_TKZ: cur_SELECT_LINE_macos_v1_TKZ {
            label = "&CUR_SELECT_LINE_MACOS_V1_TKZ";
            compatible = "zmk,behavior-macro";
            #binding-cells = <0>;
            tap-ms = <1>;
            wait-ms = <1>;
            bindings = <&kp LG(LEFT)>
                , <&kp LG(LS(RIGHT))>;
        };

        // Cursor Layer - Select Line (seq) - TailorKey
        cur_SELECT_LINE_v1_TKZ: cur_SELECT_LINE_v1_TKZ {
            label = "&CUR_SELECT_LINE_V1_TKZ";
            compatible = "zmk,behavior-macro";
            #binding-cells = <0>;
            tap-ms = <1>;
            wait-ms = <1>;
            bindings = <&kp HOME>
                , <&kp LS(END)>;
        };

        // Cursor Layer - Select None (seq) - TailorKey
        cur_SELECT_NONE_v1_TKZ: cur_SELECT_NONE_v1_TKZ {
            label = "&CUR_SELECT_NONE_V1_TKZ";
            compatible = "zmk,behavior-macro";
            #binding-cells = <0>;
            tap-ms = <1>;
            wait-ms = <1>;
            bindings = <&kp DOWN>
                , <&kp UP>
                , <&kp RIGHT>
                , <&kp LEFT>;
        };

        // Cursor Layer - Select Word (seq) - TailorKey
        cur_SELECT_WORD_macos_v1_TKZ: cur_SELECT_WORD_macos_v1_TKZ {
            label = "&CUR_SELECT_WORD_MACOS_V1_TKZ";
            compatible = "zmk,behavior-macro";
            #binding-cells = <0>;
            tap-ms = <1>;
            wait-ms = <1>;
            bindings = <&kp LA(LEFT)>
                , <&kp LA(LS(RIGHT))>;
        };

        // Cursor Layer - Select Word (seq) - TailorKey
        cur_SELECT_WORD_v1_TKZ: cur_SELECT_WORD_v1_TKZ {
            label = "&CUR_SELECT_WORD_V1_TKZ";
            compatible = "zmk,behavior-macro";
            #binding-cells = <0>;
            tap-ms = <1>;
            wait-ms = <1>;
            bindings = <&kp LC(LEFT)>
                , <&kp LC(LS(RIGHT))>;
        };

        // mod_tab_switcher_chord -  TailorKey
        mod_tab_chord_v2_TKZ: mod_tab_chord_v2_TKZ {
            label = "&MOD_TAB_CHORD_V2_TKZ";
            compatible = "zmk,behavior-macro-two-param";
            #binding-cells = <2>;
            tap-ms = <0>;
            wait-ms = <0>;
            bindings = <&macro_press>
                , <&macro_param_2to1>
                , <&mo MACRO_PLACEHOLDER>
                , <&macro_press>
                , <&macro_param_1to1>
                , <&mod_tab_v2_TKZ MACRO_PLACEHOLDER>
                , <&macro_pause_for_release>
                , <&macro_release>
                , <&macro_param_1to1>
                , <&mod_tab_v2_TKZ MACRO_PLACEHOLDER>
                , <&macro_release>
                , <&macro_param_2to1>
                , <&mo MACRO_PLACEHOLDER>;
        };

        // mod_tab_switcher - TailorKey
        //
        //
        mod_tab_v2_TKZ: mod_tab_v2_TKZ {
            label = "&MOD_TAB_V2_TKZ";
            compatible = "zmk,behavior-macro-one-param";
            #binding-cells = <1>;
            tap-ms = <0>;
            wait-ms = <0>;
            bindings = <&macro_press>
                , <&macro_param_1to1>
                , <&kp MACRO_PLACEHOLDER>
                , <&macro_tap>
                , <&kp TAB>
                , <&macro_pause_for_release>
                , <&macro_release>
                , <&macro_param_1to1>
                , <&kp MACRO_PLACEHOLDER>;
        };

        // macro string1 sample - Magic Layer F1 - Text output sample macro 1 "¡Hola!" - TailorKey
        mstr1_v1_TKZ: mstr1_v1_TKZ {
            label = "&MSTR1_V1_TKZ";
            compatible = "zmk,behavior-macro";
            #binding-cells = <0>;
            bindings = <&macro_press>
                , <&kp RALT>
                , <&macro_tap>
                , <&kp KP_N0>
                , <&kp KP_N1>
                , <&kp KP_N6>
                , <&kp KP_N1>
                , <&macro_release>
                , <&kp RALT>
                , <&macro_press>
                , <&kp LSHFT>
                , <&macro_tap>
                , <&kp H>
                , <&macro_release>
                , <&kp LSHFT>
                , <&macro_tap>
                , <&kp O>
                , <&kp L>
                , <&kp A>
                , <&kp EXCL>
                , <&kp SPACE>
                , <&kp RET>;
        };

        // macro string2 sample - Magic Layer F2 - Text output sample macro 2 "grammar check: <paste>" - TailorKey
        mstr2_v1_TKZ: mstr2_v1_TKZ {
            label = "&MSTR2_V1_TKZ";
            compatible = "zmk,behavior-macro";
            #binding-cells = <0>;
            bindings = <&macro_tap>
                , <&kp G>
                , <&kp R>
                , <&kp A>
                , <&kp M>
                , <&kp M>
                , <&kp A>
                , <&kp R>
                , <&kp SPACE>
                , <&kp C>
                , <&kp H>
                , <&kp E>
                , <&kp C>
                , <&kp K>
                , <&kp COLON>
                , <&kp LC(V)>
                , <&kp RET>;
        };

        // Symbol layer dot dot
        symb_dotdot_v1_TKZ: symb_dotdot_v1_TKZ {
            label = "&SYMB_DOTDOT_V1_TKZ";
            compatible = "zmk,behavior-macro";
            #binding-cells = <0>;
            tap-ms = <0>;
            wait-ms = <0>;
            bindings = <&macro_tap>
                , <&kp DOT>
                , <&kp DOT>;
        };
    };
};

/* Automatically generated behavior definitions */
/ {
    behaviors {


        // AutoShift Helper - &AS main macro is chained to &AS_HT hold tap and &AS_Shifted macro. For faster typists, it is recommended to decrease the tapping-term-ms value. A suggested value is 135 ms.
        // More: https://github.com/nickcoutsos/keymap-editor/wiki/Autoshift-using-ZMK-behaviors
        AS_HT_v2_TKZ: AS_HT_v2_TKZ {
            compatible = "zmk,behavior-hold-tap";
            #binding-cells = <2>;
            tapping-term-ms = <190>;
            bindings = <&AS_Shifted_v1_TKZ>, <&kp>;
            flavor = "tap-preferred";
        };

        // Capsword helper - tap for caps_word - hold for key press
        CAPSWord_v1_TKZ: CAPSWord_v1_TKZ {
            compatible = "zmk,behavior-hold-tap";
            #binding-cells = <2>;
            tapping-term-ms = <200>;
            bindings = <&kp>, <&caps_word>;
        };

        // Homerow Mod for the left index finger - TailorKey.
        // For advanced tuning of HRM values, see: https://docs.google.com/spreadsheets/d/1ESgObQelyz4lnKlfwLYsmofLJulOMK5RdGBsopLe2o8
        HRM_left_index_v1_TKZ: HRM_left_index_v1_TKZ {
            compatible = "zmk,behavior-hold-tap";
            #binding-cells = <2>;
            tapping-term-ms = <190>;
            bindings = <&kp>, <&kp>;
            flavor = "tap-preferred";
            quick-tap-ms = <300>;
            require-prior-idle-ms = <100>;
            hold-trigger-key-positions = <57 56 55 72 73 74 5 6 7 8 16 17 18 19 20 28 29 30 31 32 40 41 42 43 44 58 59 60 61 62 75 76 77 78 9 21 33 45 63 79 52 53 54 70 71 69>;
            hold-trigger-on-release;
        };

        // Homerow Mod for the left middle finger - TailorKey
        HRM_left_middy_v1_TKZ: HRM_left_middy_v1_TKZ {
            compatible = "zmk,behavior-hold-tap";
            #binding-cells = <2>;
            tapping-term-ms = <210>;
            bindings = <&kp>, <&kp>;
            flavor = "tap-preferred";
            quick-tap-ms = <300>;
            require-prior-idle-ms = <150>;
            hold-trigger-key-positions = <57 56 55 72 73 74 5 6 7 8 16 17 18 19 20 28 29 30 31 32 40 41 42 43 44 58 59 60 61 62 75 76 77 78 9 21 33 45 63 79 52 53 54 69 70 71>;
            hold-trigger-on-release;
        };

        // Homerow Mod for the left pinky - TailorKey
        HRM_left_pinky_v1_TKZ: HRM_left_pinky_v1_TKZ {
            compatible = "zmk,behavior-hold-tap";
            #binding-cells = <2>;
            tapping-term-ms = <280>;
            bindings = <&kp>, <&kp>;
            flavor = "tap-preferred";
            quick-tap-ms = <300>;
            require-prior-idle-ms = <150>;
            hold-trigger-key-positions = <57 56 55 72 73 74 5 6 7 8 9 16 17 18 19 20 21 29 30 31 32 33 42 43 44 45 60 61 62 63 28 40 41 58 59 75 76 77 79 78 52 53 54 69 70 71>;
            hold-trigger-on-release;
        };

        // Homerow Mod for the left ring finger 1 - TailorKey
        HRM_left_ring_v1_TKZ: HRM_left_ring_v1_TKZ {
            compatible = "zmk,behavior-hold-tap";
            #binding-cells = <2>;
            tapping-term-ms = <240>;
            bindings = <&kp>, <&kp>;
            flavor = "tap-preferred";
            quick-tap-ms = <300>;
            require-prior-idle-ms = <150>;
            hold-trigger-key-positions = <57 56 55 72 73 74 5 6 7 8 16 17 18 19 20 28 29 30 31 32 40 41 42 43 44 58 59 60 61 62 75 76 77 78 9 21 33 45 63 79 52 53 54 69 70 71>;
            hold-trigger-on-release;
        };

        // Homerow Mod for the right index finger - TailorKey
        HRM_right_index_v1_TKZ: HRM_right_index_v1_TKZ {
            compatible = "zmk,behavior-hold-tap";
            #binding-cells = <2>;
            tapping-term-ms = <190>;
            bindings = <&kp>, <&kp>;
            flavor = "tap-preferred";
            quick-tap-ms = <300>;
            require-prior-idle-ms = <100>;
            hold-trigger-key-positions = <52 53 54 71 70 69 0 1 10 11 12 13 14 22 23 24 25 26 27 34 35 36 37 38 39 46 47 48 49 50 51 64 65 66 67 68 15 4 2 3 55 56 57 72 73 74>;
            hold-trigger-on-release;
        };

        // Homerow Mod for the right middle finger - TailorKey
        HRM_right_middy_v1_TKZ: HRM_right_middy_v1_TKZ {
            compatible = "zmk,behavior-hold-tap";
            #binding-cells = <2>;
            tapping-term-ms = <210>;
            bindings = <&kp>, <&kp>;
            flavor = "tap-preferred";
            quick-tap-ms = <300>;
            require-prior-idle-ms = <150>;
            hold-trigger-key-positions = <52 53 54 71 70 69 0 1 10 11 12 13 14 22 23 24 25 26 27 34 35 36 37 38 39 46 47 48 49 50 51 64 65 66 67 68 15 4 2 3 55 56 57 72 73 74>;
            hold-trigger-on-release;
        };

        // Homerow Mod for the right pinky - TailorKey
        HRM_right_pinky_v1_TKZ: HRM_right_pinky_v1_TKZ {
            compatible = "zmk,behavior-hold-tap";
            #binding-cells = <2>;
            tapping-term-ms = <280>;
            bindings = <&kp>, <&kp>;
            flavor = "tap-preferred";
            quick-tap-ms = <300>;
            require-prior-idle-ms = <150>;
            hold-trigger-key-positions = <52 53 54 71 70 69 0 1 10 11 12 13 14 22 23 24 25 26 27 34 35 36 37 38 39 46 47 48 49 50 51 64 65 66 67 68 15 4 2 3 55 56 57 72 73 74>;
            hold-trigger-on-release;
        };

        // Homerow Mod for the right ring 1 - TailorKey
        //
        HRM_right_ring_v1_TKZ: HRM_right_ring_v1_TKZ {
            compatible = "zmk,behavior-hold-tap";
            #binding-cells = <2>;
            tapping-term-ms = <240>;
            bindings = <&kp>, <&kp>;
            flavor = "tap-preferred";
            quick-tap-ms = <300>;
            require-prior-idle-ms = <150>;
            hold-trigger-key-positions = <52 53 54 71 70 69 0 1 10 11 12 13 14 22 23 24 25 26 27 34 35 36 37 38 39 46 47 48 49 50 51 64 65 66 67 68 15 4 2 3 55 56 57 72 73 74>;
            hold-trigger-on-release;
        };

        // space_layer_access - TailorKey
        space_v3_TKZ: space_v3_TKZ {
            compatible = "zmk,behavior-hold-tap";
            #binding-cells = <2>;
            tapping-term-ms = <200>;
            bindings = <&mo>, <&kp>;
            flavor = "balanced";
            quick-tap-ms = <150>;
        };

        // thumb_layer_access - TailorKey
        thumb_v2_TKZ: thumb_v2_TKZ {
            compatible = "zmk,behavior-hold-tap";
            #binding-cells = <2>;
            tapping-term-ms = <200>;
            bindings = <&mo>, <&kp>;
            flavor = "balanced";
            quick-tap-ms = <300>;
        };
    };
};

/* Automatically generated combos definitions */
/ {
      combos {
          compatible = "zmk,combos";
                  // capslock when pressing both T1's - TailorKey
        combo_capslock_v1_TKZ {
            timeout-ms = <50>;
            key-positions = <52 57>;
            bindings = <&kp CAPS>;
            layers = <0 1 3>;
        };

        // F11 on RH_C5 and RH_R1+R2 - TailorKey
        combo_F11_v1_TKZ {
            timeout-ms = <50>;
            key-positions = <8 20>;
            bindings = <&kp F11>;
            layers = <0 1 3>;
        };

        // F12 on RH_C6 and RH_R1+R2 - TailorKey
        combo_F12_v1_TKZ {
            timeout-ms = <50>;
            key-positions = <9 21>;
            bindings = <&kp F12>;
            layers = <0 1 3>;
        };

        // sticky "hyper" modifiers (Win + Alt + Ctrl + Shift) - TailorKey
        combo_sticky_hyp_rght_v1_TKZ {
            timeout-ms = <50>;
            key-positions = <74 57>;
            bindings = <&sk LG(LA(LC(LSHFT)))>;
            layers = <0 1 3>;
        };

        // sticky "meh" modifiers (Alt + Ctrl + Shift) - TailorKey
        combo_sticky_meh_rght_v1_TKZ {
            timeout-ms = <50>;
            key-positions = <73 74>;
            bindings = <&sk LA(LC(LSHFT))>;
            layers = <0 1 3>;
        };

        // toggle gaming layer - TailorKey
        combo_gaming_layer_v1_TKZ {
            timeout-ms = <50>;
            key-positions = <51 68>;
            bindings = <&tog 11>;
        };
      };
    };

/* Automatically generated keymap */
/ {
    keymap {
        compatible = "zmk,keymap";


        layer_HRM_macOS {
            bindings = <
               &kp F1                          &kp F2                        &kp F3                         &kp F4                          &kp F5                                                                                                                                                                                   &kp F6                          &kp F7                         &kp F8                              &kp F9    &kp F10
            &kp EQUAL                          &kp N1                        &kp N2                         &kp N3                          &kp N4  &kp N5                                                                                                                                          &kp N6                           &kp N7                          &kp N8                         &kp N9                              &kp N0  &kp MINUS
              &kp TAB                           &kp Q                         &kp W                          &kp E                           &kp R   &kp T                                                                                                                                           &kp Y                            &kp U                           &kp I                          &kp O                               &kp P   &kp BSLH
              &kp ESC  &HRM_left_pinky_v1_TKZ LCTRL A  &HRM_left_ring_v1_TKZ LALT S  &HRM_left_middy_v1_TKZ LGUI D  &HRM_left_index_v1_TKZ LSHFT F   &kp G                                                                                                                                           &kp H  &HRM_right_index_v1_TKZ RSHFT J  &HRM_right_middy_v1_TKZ RGUI K  &HRM_right_ring_v1_TKZ LALT L  &HRM_right_pinky_v1_TKZ RCTRL SEMI    &kp SQT
            &kp GRAVE                           &kp Z                         &kp X                          &kp C                           &kp V   &kp B  &CAPSWord_v1_TKZ LSHFT MACRO_PLACEHOLDER  &kp LGUI    &lower  &kp LCTRL             &kp RGUI  &CAPSWord_v1_TKZ RSHFT MACRO_PLACEHOLDER   &kp N                            &kp M                       &kp COMMA                        &kp DOT                            &kp FSLH  &kp PG_UP
 &magic LAYER_Magic 0                        &kp HOME                       &kp END                       &kp LEFT                       &kp RIGHT                              &thumb_v2_TKZ 4 BSPC   &kp DEL  &kp LALT   &kp RALT  &thumb_v2_TKZ 7 RET                     &space_v3_TKZ 6 SPACE                                   &kp UP                        &kp DOWN                       &kp LBKT                            &kp RBKT  &kp PG_DN
            >;
        };

        layer_HRM_WinLinx {
            bindings = <
               &kp F1                         &kp F2                        &kp F3                          &kp F4                          &kp F5                                                                                                                                                                                   &kp F6                           &kp F7                         &kp F8                             &kp F9    &kp F10
            &kp EQUAL                         &kp N1                        &kp N2                          &kp N3                          &kp N4  &kp N5                                                                                                                                          &kp N6                           &kp N7                           &kp N8                         &kp N9                             &kp N0  &kp MINUS
              &kp TAB                          &kp Q                         &kp W                           &kp E                           &kp R   &kp T                                                                                                                                           &kp Y                            &kp U                            &kp I                          &kp O                              &kp P   &kp BSLH
              &kp ESC  &HRM_left_pinky_v1_TKZ LGUI A  &HRM_left_ring_v1_TKZ LALT S  &HRM_left_middy_v1_TKZ LCTRL D  &HRM_left_index_v1_TKZ LSHFT F   &kp G                                                                                                                                           &kp H  &HRM_right_index_v1_TKZ RSHFT J  &HRM_right_middy_v1_TKZ RCTRL K  &HRM_right_ring_v1_TKZ LALT L  &HRM_right_pinky_v1_TKZ LGUI SEMI    &kp SQT
            &kp GRAVE                          &kp Z                         &kp X                           &kp C                           &kp V   &kp B  &CAPSWord_v1_TKZ LSHFT MACRO_PLACEHOLDER  &kp LCTRL    &lower  &kp LGUI            &kp RCTRL  &CAPSWord_v1_TKZ RSHFT MACRO_PLACEHOLDER   &kp N                            &kp M                        &kp COMMA                        &kp DOT                           &kp FSLH  &kp PG_UP
 &magic LAYER_Magic 0                       &kp HOME                       &kp END                        &kp LEFT                       &kp RIGHT                              &thumb_v2_TKZ 5 BSPC    &kp DEL  &kp LALT  &kp RALT  &thumb_v2_TKZ 7 RET                     &space_v3_TKZ 6 SPACE                                   &kp UP                         &kp DOWN                       &kp LBKT                           &kp RBKT  &kp PG_DN
            >;
        };

        layer_Typing {
            bindings = <
 &trans  &trans  &trans  &trans  &trans                                                                  &trans  &trans  &trans    &trans  &trans
 &trans  &trans  &trans  &trans  &trans  &trans                                                  &trans  &trans  &trans  &trans    &trans  &trans
 &trans  &trans  &trans  &trans  &trans  &trans                                                  &trans  &trans  &trans  &trans    &trans  &trans
 &trans   &kp A   &kp S   &kp D   &kp F  &trans                                                  &trans   &kp J   &kp K   &kp L  &kp SEMI  &trans
 &trans  &trans  &trans  &trans  &trans  &trans  &trans  &trans  &trans  &trans  &trans  &trans  &trans  &trans  &trans  &trans    &trans  &trans
 &trans  &trans  &trans  &trans  &trans          &trans  &trans  &trans  &trans  &trans  &trans          &trans  &trans  &trans    &trans  &trans
            >;
        };

        layer_Autoshift {
            bindings = <
               &trans         &trans         &trans         &trans         &trans                                                                                       &trans            &trans           &trans           &trans            &trans
     &AS_v1_TKZ EQUAL  &AS_v1_TKZ N1  &AS_v1_TKZ N2  &AS_v1_TKZ N3  &AS_v1_TKZ N4  &AS_v1_TKZ N5                                                  &AS_v1_TKZ N6  &AS_v1_TKZ N7     &AS_v1_TKZ N8    &AS_v1_TKZ N9    &AS_v1_TKZ N0  &AS_v1_TKZ MINUS
               &trans   &AS_v1_TKZ Q   &AS_v1_TKZ W   &AS_v1_TKZ E   &AS_v1_TKZ R   &AS_v1_TKZ T                                                   &AS_v1_TKZ Y   &AS_v1_TKZ U      &AS_v1_TKZ I     &AS_v1_TKZ O     &AS_v1_TKZ P   &AS_v1_TKZ BSLH
               &trans   &AS_v1_TKZ A   &AS_v1_TKZ S   &AS_v1_TKZ D   &AS_v1_TKZ F   &AS_v1_TKZ G                                                   &AS_v1_TKZ H   &AS_v1_TKZ J      &AS_v1_TKZ K     &AS_v1_TKZ L  &AS_v1_TKZ SEMI    &AS_v1_TKZ SQT
     &AS_v1_TKZ GRAVE   &AS_v1_TKZ Z   &AS_v1_TKZ X   &AS_v1_TKZ C   &AS_v1_TKZ V   &AS_v1_TKZ B  &trans  &trans  &trans  &trans  &trans  &trans   &AS_v1_TKZ N   &AS_v1_TKZ M  &AS_v1_TKZ COMMA   &AS_v1_TKZ DOT  &AS_v1_TKZ FSLH            &trans
 &magic LAYER_Magic 0         &trans         &trans         &trans         &trans                 &trans  &trans  &trans  &trans  &trans  &trans                        &trans            &trans  &AS_v1_TKZ LBKT  &AS_v1_TKZ RBKT            &trans
            >;
        };

        layer_Cursor_macOS {
            bindings = <
     &none      &none                          &none                          &none      &none                                                                                                                                                                              &none          &none          &none      &none      &none
     &none    &kp ESC                        &kp INS                    &kp LS(TAB)    &kp DEL      &none                                                                                                                                                      &none        &none          &none          &none      &none      &none
     &none    &kp RET                      &kp SPACE                        &kp TAB   &kp BSPC  &kp LG(X)                                                                                                                                                  &kp LG(X)  &kp LS(TAB)      &kp LG(Z)  &kp LG(LS(Z))    &kp TAB      &none
 &sk LSHFT  &kp LCTRL                       &kp LALT                       &kp LGUI  &kp LSHFT  &kp LG(C)                                                                                                                                                  &kp LG(C)     &kp LEFT         &kp UP       &kp DOWN  &kp RIGHT  &sk RSHFT
 &kp LG(L)  &kp LG(A)  &cur_SELECT_LINE_macos_v1_TKZ  &cur_SELECT_WORD_macos_v1_TKZ  &kp LG(F)  &kp LG(V)  &mod_tab_v2_TKZ LGUI   &mod_tab_v2_TKZ LALT   &kp PSCRN  &cur_SELECT_NONE_v1_TKZ  &cur_EXTEND_LINE_macos_v1_TKZ  &cur_EXTEND_WORD_macos_v1_TKZ  &kp LG(V)     &kp HOME      &kp PG_UP      &kp PG_DN    &kp END  &kp LG(L)
 &kp LG(K)  &kp LG(Z)                  &kp LG(LS(Z))                  &kp LG(LS(G))  &kp LG(G)                            &none  &mod_tab_v2_TKZ LCTRL  &kp LG(F3)                &kp LG(A)  &cur_SELECT_LINE_macos_v1_TKZ  &cur_SELECT_WORD_macos_v1_TKZ               &kp LG(F)  &kp LG(LS(G))      &kp LG(G)  &kp LC(H)  &kp LG(K)
            >;
        };

        layer_Cursor {
            bindings = <
     &none      &none                    &none                    &none      &none                                                                                                                                                                 &none          &none      &none      &none      &none
     &none    &kp ESC                  &kp INS              &kp LS(TAB)    &kp DEL      &none                                                                                                                                         &none        &none          &none      &none      &none      &none
     &none    &kp RET                &kp SPACE                  &kp TAB   &kp BSPC  &kp LC(X)                                                                                                                                     &kp LC(X)  &kp LS(TAB)      &kp LC(Z)  &kp LC(Y)    &kp TAB      &none
 &sk LSHFT   &kp LGUI                 &kp LALT                &kp LCTRL  &kp LSHFT  &kp LC(C)                                                                                                                                     &kp LC(C)     &kp LEFT         &kp UP   &kp DOWN  &kp RIGHT  &sk RSHFT
 &kp LC(L)  &kp LC(A)  &cur_SELECT_LINE_v1_TKZ  &cur_SELECT_WORD_v1_TKZ  &kp LC(F)  &kp LC(V)  &mod_tab_v2_TKZ LALT   &mod_tab_v2_TKZ LGUI  &kp PSCRN  &cur_SELECT_NONE_v1_TKZ  &cur_EXTEND_LINE_v1_TKZ  &cur_EXTEND_WORD_v1_TKZ  &kp LC(V)     &kp HOME      &kp PG_UP  &kp PG_DN    &kp END  &kp LC(L)
 &kp LC(K)  &kp LC(Z)                &kp LC(Y)            &kp LC(LS(G))  &kp LC(G)                            &none  &mod_tab_v2_TKZ LCTRL  &kp LG(D)                &kp LC(A)  &cur_SELECT_LINE_v1_TKZ  &cur_SELECT_WORD_v1_TKZ               &kp LC(F)  &kp LC(LS(G))  &kp LC(G)  &kp LC(H)  &kp LC(K)
            >;
        };

        layer_Symbol {
            bindings = <
               &none      &none      &none      &none      &none                                                                                    &none        &none      &none     &none   &none
           &kp GRAVE   &kp RBKT   &kp LPAR   &kp RPAR  &kp COMMA    &kp DOT                                                              &none      &none        &none      &none     &none   &none
            &kp LBKT   &kp EXCL   &kp LBRC   &kp RBRC   &kp SEMI  &kp QMARK                                                          &kp GRAVE  &sk RSHFT    &sk RCTRL   &sk RALT  &sk RGUI   &none
            &kp HASH  &kp CARET  &kp EQUAL  &kp UNDER   &kp DLLR   &kp STAR                                                            &kp DQT   &kp BSPC      &kp TAB  &kp SPACE   &kp RET   &none
           &kp TILDE     &kp LT   &kp PIPE  &kp MINUS     &kp GT   &kp FSLH   &kp BSLH    &kp DOT  &kp STAR   &none   &none   &none    &kp SQT    &kp DEL  &kp LS(TAB)    &kp INS   &kp ESC   &none
 &symb_dotdot_v1_TKZ   &kp AMPS    &kp SQT    &kp DQT   &kp PLUS             &kp PRCNT  &kp COLON    &kp AT   &none   &none   &none                 &none        &none      &none     &none   &none
            >;
        };

        layer_Mouse {
            bindings = <
  &none           &none           &none           &none            &none                                                                                                   &none           &none            &none      &none      &none
  &none           &none           &none           &none            &none           &none                                                                   &none           &none           &none            &none      &none      &none
  &none           &none  &msc SCRL_LEFT    &mmv MOVE_UP  &msc SCRL_RIGHT           &none                                                                   &none       &sk RSHFT       &sk RCTRL         &sk RALT   &sk RGUI      &none
  &none    &msc SCRL_UP  &mmv MOVE_LEFT  &mmv MOVE_DOWN  &mmv MOVE_RIGHT    &msc SCRL_UP                                                            &msc SCRL_UP           &mo 9          &mo 10            &mo 8  &mkp LCLK   &mkp MB4
  &none  &msc SCRL_DOWN           &mo 8          &mo 10            &mo 9  &msc SCRL_DOWN  &mkp MCLK  &kp K_APP  &mkp MB5   &none   &none   &none  &msc SCRL_DOWN  &msc SCRL_LEFT    &mmv MOVE_UP  &msc SCRL_RIGHT  &mkp RCLK   &mkp MB5
  &none           &none           &none           &none            &none                  &mkp LCLK  &mkp RCLK  &mkp MB4   &none   &none   &none                  &mmv MOVE_LEFT  &mmv MOVE_DOWN  &mmv MOVE_RIGHT  &mkp MCLK  &kp K_APP
            >;
        };

        layer_MouseSlow {
            bindings = <
 &trans  &trans  &trans  &trans  &trans                                                                  &trans  &trans  &trans  &trans  &trans
 &trans  &trans  &trans  &trans  &trans  &trans                                                  &trans  &trans  &trans  &trans  &trans  &trans
 &trans  &trans  &trans  &trans  &trans  &trans                                                  &trans  &trans  &trans  &trans  &trans  &trans
 &trans  &trans  &trans  &trans  &trans  &trans                                                  &trans  &trans  &trans  &trans  &trans  &trans
 &trans  &trans  &trans  &trans  &trans  &trans  &trans  &trans  &trans  &trans  &trans  &trans  &trans  &trans  &trans  &trans  &trans  &trans
 &trans  &trans  &trans  &trans  &trans          &trans  &trans  &trans  &trans  &trans  &trans          &trans  &trans  &trans  &trans  &trans
            >;
        };

        layer_MouseFast {
            bindings = <
 &trans  &trans  &trans  &trans  &trans                                                                  &trans  &trans  &trans  &trans  &trans
 &trans  &trans  &trans  &trans  &trans  &trans                                                  &trans  &trans  &trans  &trans  &trans  &trans
 &trans  &trans  &trans  &trans  &trans  &trans                                                  &trans  &trans  &trans  &trans  &trans  &trans
 &trans  &trans  &trans  &trans  &trans  &trans                                                  &trans  &trans  &trans  &trans  &trans  &trans
 &trans  &trans  &trans  &trans  &trans  &trans  &trans  &trans  &trans  &trans  &trans  &trans  &trans  &trans  &trans  &trans  &trans  &trans
 &trans  &trans  &trans  &trans  &trans          &trans  &trans  &trans  &trans  &trans  &trans          &trans  &trans  &trans  &trans  &trans
            >;
        };

        layer_MouseWarp {
            bindings = <
 &trans  &trans  &trans  &trans  &trans                                                                  &trans  &trans  &trans  &trans  &trans
 &trans  &trans  &trans  &trans  &trans  &trans                                                  &trans  &trans  &trans  &trans  &trans  &trans
 &trans  &trans  &trans  &trans  &trans  &trans                                                  &trans  &trans  &trans  &trans  &trans  &trans
 &trans  &trans  &trans  &trans  &trans  &trans                                                  &trans  &trans  &trans  &trans  &trans  &trans
 &trans  &trans  &trans  &trans  &trans  &trans  &trans  &trans  &trans  &trans  &trans  &trans  &trans  &trans  &trans  &trans  &trans  &trans
 &trans  &trans  &trans  &trans  &trans          &trans  &trans  &trans  &trans  &trans  &trans          &trans  &trans  &trans  &trans  &trans
            >;
        };

        layer_Gaming {
            bindings = <
 &kp ESC      &kp P   &kp O   &kp N  &kp BSPC                                                                                   &kp F1     &kp F2    &kp F3    &kp F4     &kp F5
   &kp M     &kp N6  &kp N7  &kp N8    &kp N9  &kp N0                                                                &kp F6     &kp F7     &kp F8    &kp F9   &kp F10    &kp F11
   &kp I     &kp N1  &kp N2  &kp N3    &kp N4  &kp N5                                                                 &kp Y      &kp U      &kp I     &kp O     &kp P    &kp F12
   &kp T    &kp TAB   &kp Q   &kp W     &kp E   &kp R                                                                 &kp H      &kp J      &kp K     &kp L  &kp SEMI    &kp SQT
   &kp G  &kp LSHFT   &kp A   &kp S     &kp D   &kp F  &kp LSHFT   &kp LALT    &kp V   &kp ESC    &kp UP    &kp RET   &kp N      &kp M  &kp COMMA   &kp DOT  &kp FSLH  &kp MINUS
   &kp B  &kp LCTRL   &kp Z   &kp X     &kp C          &kp SPACE  &kp LCTRL  &kp RET  &kp LEFT  &kp DOWN  &kp RIGHT          &kp GRAVE   &kp LBKT  &kp RBKT  &kp BSLH  &kp EQUAL
            >;
        };

        layer_Lower {
            bindings = <
         &kp C_BRI_DN  &kp C_BRI_UP      &kp C_PREV      &kp C_NEXT         &kp C_PP                                                                                      &kp C_MUTE  &kp C_VOL_DN  &kp C_VOL_UP            &none  &kp PAUSE_BREAK
               &trans         &none           &none           &none            &none   &kp HOME                                                     &kp LEFT_PARENTHESIS  &kp KP_NUM     &kp EQUAL  &kp KP_SLASH  &kp KP_MULTIPLY  &kp PRINTSCREEN
               &trans         &none           &none    &kp UP_ARROW            &none    &kp END                                                    &kp RIGHT_PARENTHESIS   &kp KP_N7     &kp KP_N8     &kp KP_N9     &kp KP_MINUS   &kp SCROLLLOCK
               &trans         &none  &kp LEFT_ARROW  &kp DOWN_ARROW  &kp RIGHT_ARROW  &kp PG_UP                                                              &kp PERCENT   &kp KP_N4     &kp KP_N5     &kp KP_N6      &kp KP_PLUS            &none
               &trans     &kp K_APP           &none         &kp F11          &kp F12  &kp PG_DN  &trans  &kp F24   &to 1  &kp F24  &trans  &trans              &kp COMMA   &kp KP_N1     &kp KP_N2     &kp KP_N3     &kp KP_ENTER           &trans
 &magic LAYER_Magic 0      &kp CAPS         &kp INS         &kp F11          &kp F12             &trans   &trans  &trans   &trans  &trans  &trans                          &kp KP_N0     &kp KP_N0    &kp KP_DOT     &kp KP_ENTER           &trans
            >;
        };

        layer_Magic {
            bindings = <
 &mstr1_v1_TKZ    &mstr2_v1_TKZ            &none            &none            &none                                                                                  &none   &none   &none  &bt BT_CLR  &bt BT_CLR_ALL
         &to 0            &to 1            &to 2            &none            &none            &to 3                                                         &none   &none   &none   &none       &none           &none
         &none  &rgb_ug RGB_SPI  &rgb_ug RGB_SAI  &rgb_ug RGB_HUI  &rgb_ug RGB_BRI  &rgb_ug RGB_TOG                                                         &none   &none   &none   &none       &none           &none
   &bootloader  &rgb_ug RGB_SPD  &rgb_ug RGB_SAD  &rgb_ug RGB_HUD  &rgb_ug RGB_BRD  &rgb_ug RGB_EFF                                                         &none   &none   &none   &none       &none     &bootloader
    &sys_reset            &none            &none            &none            &none            &none   &bt_2   &bt_3         &none   &none   &none   &none   &none   &none   &none   &none       &none      &sys_reset
         &none            &none            &none            &none            &none                    &bt_0   &bt_1  &out OUT_USB   &none   &none   &none           &none   &none   &none       &none           &none
            >;
        };

    };
};
